/* CPU speed benchmark which measures the time to digitally sign
   a string using SHA256 digest and RSA2048.
*/

#include "local_rsa_sign.h"

extern const uint8_t known_correct_signature[];

void setup()
{
	// Startup & prepatory stuff
	Serial.begin(9600);
	while (!Serial) ; // wait for Arduino Serial Monitor
	delay(1000);
	Serial.println("RSA Signature Speed Test");
	Serial.println();
	rsa_init();
	delay(100);

	// Run the speed benchmark
	uint8_t signature[256];
	uint32_t begin_usec = micros();
	rsa_sign_string("Sample plaintext string to be signed", signature);
	uint32_t end_usec = micros();

	// Print results
	Serial.print("Signature computation took ");
	Serial.print((float)(end_usec - begin_usec) * 1.0e-6, 3);
	Serial.println(" seconds");
	Serial.println();
	for (int i = 0; i < 256; i++) {
		if (signature[i] < 16) Serial.print('0');
		Serial.print(signature[i], HEX);
		if ((i + 1) % 16 == 0) {
			Serial.println();
		} else {
			Serial.print(' ');
		}
	}

	// Verify the computed result
	if (memcmp(signature, known_correct_signature, 256) == 0) {
		Serial.println("Signature is good :-)");
	} else {
		Serial.println("ERROR: Signature is not correct!");
	}
}

void loop()
{
}

// Known good result was obtained with this command:
//  echo -n "Sample plaintext string to be signed" | openssl dgst -sha256 -sign mykey.key | hd -v
// See comments in local_rsa_sign.c for generating the RSA key.

const uint8_t known_correct_signature[256] = {
0x22,0x14,0xf7,0x95,0xb6,0x7b,0x7e,0xfd, 0xc5,0x9e,0x6c,0x3d,0xbd,0x28,0xcb,0x93,
0xaf,0x2c,0x94,0x21,0xc7,0x88,0xa3,0xd3, 0x6a,0x37,0xdd,0x26,0xd9,0x9f,0xfc,0x5c,
0xe7,0xdc,0xab,0x51,0xdb,0xdf,0x3e,0x54, 0xfa,0x4b,0xfc,0x8d,0x8a,0x09,0x51,0x58,
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0x0c,0xaf,0xfe,0x1d,0xe1,0x6b,0x34,0x1b, 0x36,0x0f,0x6c,0x62,0x0f,0xcd,0x11,0x48
};

